## drivers/channel/Kconfig
```kconfig
# SPDX-License-Identifier: GPL-2.0

config CHANNEL
	bool "Islet inter co-resident realm communication support"
	help
	  The channel is a module to communicate with co-resident realms on the same host.
	  The channel module communicates with channel device driver in realms using 
	  virtual interrupts.

if CHANNEL

config GUEST_CHANNEL
	bool "Support CHANNEL on guest side"
	depends on CHANNEL
	help
	  The guest channel is a module to communicate with co-resident realms on the same host.
	  The channel module communicates with channel device driver in realms using 
	  virtual interrupts.
	  In addition, this module can get dynamic shared memory from host channel module to
	  share it with co-resident realms.

config HOST_CHANNEL
	bool "Support CHANNEL on host side"
	depends on CHANNEL
	help
	  The host channel module can send or receive interrupt to or from  other channel module
	  in realm to allocate and deallocate dynamic shared memory.
	  Note that it should be disabled on realm kernel.

config INTER_REALM_SHM_SIZE_8KB
	bool "8KB"
	depends on HOST_CHANNEL
	help
	  This enables support for 8KB pages for inter co-resident realms shared memory

config INTER_REALM_SHM_SIZE_16KB
	bool "16KB"
	depends on HOST_CHANNEL
	help
	  This enables support for 16KB pages for inter co-resident realms shared memory

config INTER_REALM_SHM_SIZE_32KB
	bool "16KB"
	depends on HOST_CHANNEL
	help
	  This enables support for 32KB pages for inter co-resident realms shared memory

config INTER_REALM_SHM_SIZE_64KB
	bool "16KB"
	depends on HOST_CHANNEL
	help
	  This enables support for 64KB pages for inter co-resident realms shared memory

endif # CHANNEL
```
