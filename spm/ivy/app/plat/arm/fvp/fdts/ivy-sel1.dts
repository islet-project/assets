/*
 * Copyright (c) 2018-2022, Arm Limited. All rights reserved.
 *
 * SPDX-License-Identifier: BSD-3-Clause
 *
 * This file is a Partition Manifest (PM) for a minimal Secure Partition (SP)
 * intended to run at S-EL0 utilising a shim to run at S-EL1 on a
 * non VHE enabled hafnium.
 */


/dts-v1/;

/ {
	compatible = "arm,ffa-manifest-1.0";

	/* Properties */
	description = "ivy-sel1-fvp";
	ffa-version = <0x00010001>; /* 31:16 - Major, 15:0 - Minor */
	uuid = <0xd883baea 0xaf4eafba 0xfdf74481 0xa744e5cb>;
	execution-ctx-count = <1>;
	exception-level = <2>; /* S-EL1 */
	execution-state = <0>; /* AARCH64 */
	load-address = <0x7600000>;
	entrypoint-offset = <0x00004000>;
	boot-order = <0>;
	messaging-method = <3>; /* Direct messaging only */
	/* Non-secure interrupts are signaled by default. */

	/* Boot protocol */
	gp-register-num = <0x0>;
};
